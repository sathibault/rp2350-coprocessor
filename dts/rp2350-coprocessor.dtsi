/ {
  soc {
	coprocessor: coprocessor@d0000050 {
		/* Base address is SIO_BASE (0xd0000000) + first register offset (0x50) */
		compatible = "rp,rp2350-coprocessor";
		/* * The register map starts at 0xd0000050 (0xd0000000 + 0x50) 
		 * and covers 3 registers (4 bytes each) up to 0x58. 
		 * Size required is (0x58 - 0x50) + 4 = 0x0C bytes.
		 */
		reg = <0xd0000050 0xC>;
		label = "RP2350_COPROCESSOR";

		/* IRQ for FIFO status change (Interrupt 25 for SIO/Inter-core Comm) */
		interrupts = <25 0>;
		status = "okay";
	};
  };
};